## config/west.yml
```yaml
manifest:
  remotes:
    - name: zmkfirmware
      url-base: https://github.com/zmkfirmware
    - name: ZitaoTech
      url-base: https://github.com/ZitaoTech
    - name: thoughtfix
      url-base: https://github.com/thoughtfix
    - name: jhob101
      url-base: https://github.com/jhob101
  projects:
    - name: zmk
      remote: jhob101
      revision: uconsole-port
      import: app/west.yml
  self:
    path: config
```
